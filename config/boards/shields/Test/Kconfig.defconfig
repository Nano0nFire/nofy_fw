## config/boards/shields/Test/Kconfig.defconfig
```kconfig
if SHIELD_NOFY_R

config ZMK_KEYBOARD_NAME
    default "nofy_R"

config ZMK_SPLIT
    default y

config ZMK_SPLIT_ROLE_CENTRAL
    default y

endif

if SHIELD_NOFY_L

config ZMK_KEYBOARD_NAME
    default "nofy_L"

config ZMK_SPLIT
    default y

endif
```

## config/boards/shields/nofy/Kconfig.shield
```kconfig
config SHIELD_NOFY_R
    def_bool $(shields_list_contains,nofy_R)

config SHIELD_NOFY_L
    def_bool $(shields_list_contains,nofy_L)
```

## config/west.yml
```yaml
manifest:
  remotes:
    - name: zmkfirmware
      url-base: https://github.com/zmkfirmware
    - name: Nano0nFire
      url-base: https://github.com/Nano0nFire
    - name: badjeff    # <-- PMW3610
      url-base: https://github.com/badjeff

  projects:
    - name: zmk
      remote: zmkfirmware
      revision: main
      import: app/west.yml
    - name: zmk-pmw3610-driver
      remote: badjeff
      revision: main

  self:
    path: config
```
