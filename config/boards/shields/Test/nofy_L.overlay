#include "nofy.dtsi"

&kscan0 {
    compatible = "zmk,kscan-gpio-charlieplex";
    interrupt-gpios = <&xiao_d 1 (GPIO_ACTIVE_LOW)>;
    gpios
        = <&xiao_d 2 (GPIO_ACTIVE_LOW)>
        , <&xiao_d 3 (GPIO_ACTIVE_LOW)>
        , <&xiao_d 6 (GPIO_ACTIVE_LOW)>
        , <&xiao_d 8 (GPIO_ACTIVE_LOW)>
        , <&xiao_d 9 (GPIO_ACTIVE_LOW)>
        , <&xiao_d 10 GPIO_ACTIVE_LOW>
        ;
};

&left_encoder {
    status = "okay";
};

&sensors {
    sensors = <&left_encoder>;
};